## sensors/sample.yaml
```yaml
sample:
  name: STEVAL-IDI003V2 Sensor Board
tests:
  sample.sensor.lis2dh:
    harness: sensor
    tags: samples sensor
    depends_on: i2c lis2dh
  sample.sensor.hts221:
    harness: sensor
    tags: samples sensor
    depends_on: i2c hts221
```
